## configs/ifc6401_defconfig
```kconfig
BR2_arm=y
BR2_cortex_a9=y
BR2_ARM_ENABLE_NEON=y
BR2_ARM_ENABLE_VFP=y
BR2_ARM_FPU_VFPV3=y
BR2_CCACHE=y
BR2_ENABLE_DEBUG=y
BR2_GLOBAL_PATCH_DIR="patches"
BR2_PACKAGE_USER_SESSION_UNITS=y
BR2_PACKAGE_EGALAX_I2C=y
BR2_TOOLCHAIN_EXTERNAL=y
BR2_TOOLCHAIN_GLIBC_GCONV_LIBS_COPY=y
BR2_TARGET_OPTIMIZATION="-funwind-tables -fno-omit-frame-pointer"
BR2_INIT_SYSTEMD=y
BR2_ROOTFS_DEVICE_TABLE="board/ifc6401/device_table.txt"
BR2_TARGET_GENERIC_ROOT_PASSWD="hgs"
BR2_TARGET_GENERIC_GETTY_PORT="ttyMSM0"
BR2_TARGET_TZ_INFO=y
BR2_TARGET_LOCALTIME="Europe/Berlin"
BR2_ROOTFS_USERS_TABLES="board/ifc6401/users"
BR2_ROOTFS_OVERLAY="board/ifc6401/overlay"
BR2_ROOTFS_POST_IMAGE_SCRIPT="board/ifc6401/kernel-dtb-image.sh board/ifc6401/kernel-abootimg.sh"
BR2_LINUX_KERNEL=y
BR2_LINUX_KERNEL_CUSTOM_GIT=y
BR2_LINUX_KERNEL_CUSTOM_REPO_URL="https://git.linaro.org/landing-teams/working/qualcomm/kernel.git"
BR2_LINUX_KERNEL_CUSTOM_REPO_VERSION="debian-qcom-dragonboard410c-17.04"
BR2_LINUX_KERNEL_PATCH="board/ifc6401/kernel-patches"
BR2_LINUX_KERNEL_USE_CUSTOM_CONFIG=y
BR2_LINUX_KERNEL_CUSTOM_CONFIG_FILE="board/ifc6401/linux_kernel.config"
BR2_LINUX_KERNEL_DTS_SUPPORT=y
BR2_LINUX_KERNEL_USE_CUSTOM_DTS=y
BR2_LINUX_KERNEL_CUSTOM_DTS_PATH="board/ifc6401/linux.dts"
BR2_LINUX_KERNEL_EXT_DSI85=y
BR2_PACKAGE_LINUX_TOOLS_PERF=y
BR2_PACKAGE_BUSYBOX_CONFIG="board/ifc6401/busybox.config"
BR2_PACKAGE_GST1_PLUGINS_BASE_PLUGIN_VIDEOCONVERT=y
BR2_PACKAGE_GST1_PLUGINS_BASE_PLUGIN_OGG=y
BR2_PACKAGE_GST1_PLUGINS_BASE_PLUGIN_THEORA=y
BR2_PACKAGE_GST1_PLUGINS_BASE_PLUGIN_VORBIS=y
BR2_PACKAGE_GST1_PLUGINS_GOOD=y
BR2_PACKAGE_GST1_PLUGINS_GOOD_PLUGIN_AUTODETECT=y
BR2_PACKAGE_GST1_PLUGINS_GOOD_PLUGIN_DEINTERLACE=y
BR2_PACKAGE_GST1_PLUGINS_GOOD_PLUGIN_MATROSKA=y
BR2_PACKAGE_GST1_PLUGINS_GOOD_PLUGIN_PULSE=y
BR2_PACKAGE_GST1_PLUGINS_GOOD_PLUGIN_SOUPHTTPSRC=y
BR2_PACKAGE_GST1_PLUGINS_GOOD_PLUGIN_VPX=y
BR2_PACKAGE_GST1_PLUGINS_BAD=y
BR2_PACKAGE_GST1_PLUGINS_BAD_LIB_OPENGL=y
BR2_PACKAGE_STRACE=y
BR2_PACKAGE_VALGRIND=y
BR2_PACKAGE_LIBERATION=y
BR2_PACKAGE_EFL=y
BR2_PACKAGE_EFL_WAYLAND=y
BR2_PACKAGE_EFL_PNG=y
BR2_PACKAGE_EFL_JPEG=y
BR2_PACKAGE_MESA3D=y
BR2_PACKAGE_MESA3D_GALLIUM_DRIVER_FREEDRENO=y
BR2_PACKAGE_MESA3D_GALLIUM_DRIVER_SWRAST=y
BR2_PACKAGE_MESA3D_OPENGL_EGL=y
BR2_PACKAGE_MESA3D_OPENGL_ES=y
BR2_PACKAGE_SDL2=y
BR2_PACKAGE_WESTON=y
BR2_PACKAGE_WESTON_DRM=y
BR2_PACKAGE_CRYPTSETUP=y
BR2_PACKAGE_RFKILL=y
BR2_PACKAGE_LUA_PERIPHERY=y
BR2_PACKAGE_CAIRO_PS=y
BR2_PACKAGE_IJS=y
BR2_PACKAGE_LCMS2=y
BR2_PACKAGE_LIBRSVG=y
BR2_PACKAGE_POPPLER=y
BR2_PACKAGE_WEBP=y
BR2_PACKAGE_LIBUSB_COMPAT=y
BR2_PACKAGE_LIBXSLT=y
BR2_PACKAGE_LIBSOUP_SSL=y
BR2_PACKAGE_NSS_MDNS=y
BR2_PACKAGE_ELFUTILS=y
BR2_PACKAGE_LIBUNWIND=y
BR2_PACKAGE_LINUX_PAM=y
BR2_PACKAGE_ICU=y
BR2_PACKAGE_NCURSES_WCHAR=y
BR2_PACKAGE_NCURSES_TARGET_PANEL=y
BR2_PACKAGE_NCURSES_TARGET_FORM=y
BR2_PACKAGE_NCURSES_TARGET_MENU=y
BR2_PACKAGE_GOOGLEFONTDIRECTORY=y
BR2_PACKAGE_QPDF=y
BR2_PACKAGE_SHARED_MIME_INFO=y
BR2_PACKAGE_AVAHI=y
BR2_PACKAGE_AVAHI_DAEMON=y
BR2_PACKAGE_BLUEZ5_UTILS=y
BR2_PACKAGE_CONNMAN=y
BR2_PACKAGE_CONNMAN_WIFI=y
BR2_PACKAGE_CONNMAN_BLUETOOTH=y
BR2_PACKAGE_CONNMAN_CLIENT=y
BR2_PACKAGE_CUPS=y
BR2_PACKAGE_GUTENPRINT=y
BR2_PACKAGE_HPLIP=y
BR2_PACKAGE_OPENSSH=y
BR2_PACKAGE_SOCAT=y
BR2_PACKAGE_WIRELESS_TOOLS=y
BR2_PACKAGE_WPA_SUPPLICANT_CLI=y
BR2_PACKAGE_WPA_SUPPLICANT_PASSPHRASE=y
BR2_PACKAGE_WPA_SUPPLICANT_DBUS_OLD=y
BR2_PACKAGE_WPA_SUPPLICANT_DBUS_INTROSPECTION=y
BR2_PACKAGE_SYSTEMD_HIBERNATE=y
BR2_PACKAGE_SYSTEMD_LOCALED=y
BR2_PACKAGE_SYSTEMD_LOGIND=y
# BR2_PACKAGE_SYSTEMD_NETWORKD is not set
BR2_PACKAGE_SYSTEMD_POLKIT=y
BR2_PACKAGE_SYSTEMD_VCONSOLE=y
BR2_TARGET_ROOTFS_EXT2=y
BR2_TARGET_ROOTFS_EXT2_4=y
```

## package/Igalia/chromium/Config.in
```kconfig
config BR2_PACKAGE_CHROMIUM_ARCH_SUPPORTS
	bool
	default y if BR2_arm || BR2_armeb
	default y if BR2_aarch64 || BR2_aarch64_be
	default y if BR2_i386 || BR2_x86_64
	default y if BR2_mips || BR2_mipsel || BR2_mips64 || BR2_mips64el

config BR2_PACKAGE_CHROMIUM_HOST_ARCH_SUPPORTS
	bool
	default y if BR2_HOSTARCH = "x86" || BR2_HOSTARCH = "x86_64"

config BR2_PACKAGE_CHROMIUM_TARGET_CPU
	string
	default "arm" if BR2_arm || BR2_armeb
	default "arm64" if BR2_aarch64 || BR2_aarch64_be
	default "x86" if BR2_i386
	default "x64" if BR2_x86_64
	default "mips" if BR2_mips
	default "mipsel" if BR2_mipsel
	default "mips64" if BR2_mips64
	default "mips64el" if BR2_mips64el

config BR2_PACKAGE_CHROMIUM_HOST_CPU
	string
	default "x86" if BR2_HOSTARCH = "x86"
	default "x64" if BR2_HOSTARCH = "x86_64"

config BR2_PACKAGE_CHROMIUM
    bool "Build Chromium package"
    default y
	depends on BR2_PACKAGE_CHROMIUM_ARCH_SUPPORTS
	depends on BR2_PACKAGE_CHROMIUM_HOST_ARCH_SUPPORTS
	depends on BR2_INSTALL_LIBSTDCPP
	depends on BR2_USE_WCHAR
	depends on BR2_TOOLCHAIN_HAS_THREADS
	# ICU requires an ELF system
	depends on !BR2_BINFMT_FLAT
	select BR2_PACKAGE_ALSA_LIB
	select BR2_PACKAGE_DBUS
	select BR2_PACKAGE_FONTCONFIG
	select BR2_PACKAGE_FREETYPE
	select BR2_PACKAGE_LIBGLIB2
	select BR2_PACKAGE_LIBNSS
	select BR2_PACKAGE_PCIUTILS
	select BR2_PACKAGE_PULSEAUDIO
	help
	  The Chromium web browser.

if BR2_PACKAGE_CHROMIUM

config BR2_PACKAGE_CHROMIUM_CHROMEDRIVER
	bool "Build chromedriver"
	help
	  Enables building and installing the WebDriver helper tool.

config BR2_PACKAGE_CHROMIUM_SYSTEM_ICU
	bool "Use system ICU library"
	default y
	select BR2_PACKAGE_ICU
	help
	  If disabled, use the copy of the ICU library included as part of the
	  Chromium sources; otherwise use the Buildroot ICU package.

endif

comment "chromium needs a toolchain with w/ C++, wchar"
	depends on BR2_PACKAGE_CHROMIUM_ARCH_SUPPORTS
	depends on !BR2_USE_WCHAR || !BR2_INSTALL_LIBSTDCPP

comment "chromium can only be built on a x86/x86_64 host"
	depends on BR2_PACKAGE_CHROMIUM_ARCH_SUPPORTS
	depends on !BR2_PACKAGE_CHROMIUM_HOST_ARCH_SUPPORTS
```

## package/hgs/egalax_i2c/Config.in
```kconfig
config BR2_PACKAGE_EGALAX_I2C
	bool "egalax_i2c"
	help
		the egalax_i2c kernel module
```

## package/hgs/user-session-units/Config.in
```kconfig
config BR2_PACKAGE_USER_SESSION_UNITS
	bool "user-session-units"
	depends on BR2_PACKAGE_SYSTEMD
	depends on BR2_PACKAGE_LINUX_PAM
	help
		systemd unit files for user sessions
```

## package/wpe/Config.in
```kconfig
# WPEWebKit
source "package/wpe/wpeframework/Config.in"
source "package/wpe/wpewebkit/Config.in"

if BR2_PACKAGE_WPEWEBKIT
source "package/wpe/wpebackend/Config.in"
source "package/wpe/wpebackend-rdk/Config.in"
source "package/wpe/wpelauncher/Config.in"
source "package/wpe/dyz/Config.in"
endif
```

## package/wpe/dyz/Config.in
```kconfig
config BR2_PACKAGE_DYZ
	bool "dyz"
	select BR2_PACKAGE_LUAJIT
	depends on BR2_PACKAGE_WPEWEBKIT
	help
	  dyz is just a simple launcher for WPE port of WebKit.

	  https://github.com/Igalia/dyz
```

## package/wpe/wpebackend-mesa/Config.in
```kconfig
config BR2_PACKAGE_WPEBACKEND_MESA
	bool "wpebackend-mesa"
	help
	  Mesa backend for WPE WebKit
```
